## .pio/build/frdm_kl25z/Kconfig/Kconfig.modules
```kconfig
menu "CANopenNode (C:\Users\isisk\.platformio\packages\framework-zephyr@2.20701.220422\_pio\modules\lib\canopennode)"
osource "$(ZEPHYR_CANOPENNODE_KCONFIG)"
config ZEPHYR_CANOPENNODE_MODULE
	bool
	default y
endmenu
menu "hal_nxp (C:\Users\isisk\.platformio\packages\framework-zephyr@2.20701.220422\_pio\modules\hal\nxp)"
osource "$(ZEPHYR_HAL_NXP_KCONFIG)"
config ZEPHYR_HAL_NXP_MODULE
	bool
	default y
endmenu
menu "loramac-node (C:\Users\isisk\.platformio\packages\framework-zephyr@2.20701.220422\_pio\modules\lib\loramac-node)"
osource "$(ZEPHYR_LORAMAC_NODE_KCONFIG)"
config ZEPHYR_LORAMAC_NODE_MODULE
	bool
	default y
endmenu
menu "lz4 (C:\Users\isisk\.platformio\packages\framework-zephyr@2.20701.220422\_pio\modules\lib\lz4)"
osource "$(ZEPHYR_LZ4_KCONFIG)"
config ZEPHYR_LZ4_MODULE
	bool
	default y
endmenu
menu "mbedtls (C:\Users\isisk\.platformio\packages\framework-zephyr@2.20701.220422\_pio\modules\crypto\mbedtls)"
osource "$(ZEPHYR_MBEDTLS_KCONFIG)"
config ZEPHYR_MBEDTLS_MODULE
	bool
	default y
endmenu
menu "sof (C:\Users\isisk\.platformio\packages\framework-zephyr@2.20701.220422\_pio\modules\audio\sof)"
osource "C:/Users/isisk/.platformio/packages/framework-zephyr@2.20701.220422/_pio/modules/audio/sof/zephyr/Kconfig"
config ZEPHYR_SOF_MODULE
	bool
	default y
endmenu
menu "tflite-micro (C:\Users\isisk\.platformio\packages\framework-zephyr@2.20701.220422\_pio\modules\lib\tflite-micro)"
osource "$(ZEPHYR_TFLITE_MICRO_KCONFIG)"
config ZEPHYR_TFLITE_MICRO_MODULE
	bool
	default y
endmenu
menu "TraceRecorder (C:\Users\isisk\.platformio\packages\framework-zephyr@2.20701.220422\_pio\modules\debug\TraceRecorder)"
osource "C:/Users/isisk/.platformio/packages/framework-zephyr@2.20701.220422/_pio/modules/debug/TraceRecorder/kernelports/Zephyr/Kconfig"
config ZEPHYR_TRACERECORDER_MODULE
	bool
	default y
endmenu
```
